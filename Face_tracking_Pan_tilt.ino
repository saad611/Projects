#include <ArduinoWebsockets.h>
#include <WiFi.h>
#include <ESPAsyncWebServer.h>
#include "esp_camera.h"
#include "soc/soc.h"      
#include "soc/rtc_cntl_reg.h"
#include "fb_gfx.h"
#include "fd_forward.h"


const char* ssid = "";
const char* password = "";

#define FACE_COLOR_GREEN  0x0000FF00

typedef enum
{
  START_STREAM,
  STOP_STREAM,
  TOGGLE_MOTORS_1_2,
  ACTION_MOTORS_2,
  AUTO_MODE_ON,
  AUTO_MODE_OFF,
} en_fsm_state;
en_fsm_state g_state;

boolean auto_mode = false;

const uint8_t index_html_gz[] = {0x1f,0x8b,0x08,0x08,0xc3,0x62,0x99,0x61,0x00,0xff,0x69,0x6e,0x64,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0x00 
};
#define PWDN_GPIO_NUM     32
#define RESET_GPIO_NUM    -1
#define XCLK_GPIO_NUM      0
#define SIOD_GPIO_NUM     26
#define SIOC_GPIO_NUM     27
#define Y9_GPIO_NUM       35
#define Y8_GPIO_NUM       34
#define Y7_GPIO_NUM       39
#define Y6_GPIO_NUM       36
#define Y5_GPIO_NUM       21
#define Y4_GPIO_NUM       19
#define Y3_GPIO_NUM       18
#define Y2_GPIO_NUM        5
#define VSYNC_GPIO_NUM    25
#define HREF_GPIO_NUM     23
#define PCLK_GPIO_NUM     22
 
camera_fb_t * fb = NULL;

 dl_matrix3du_t *image_matrix = NULL;
 
using namespace websockets;
WebsocketsServer WSserver;
AsyncWebServer webserver(80);

static inline mtmn_config_t app_mtmn_config()
{
  mtmn_config_t mtmn_config = {0};
  mtmn_config.type = FAST;
  mtmn_config.min_face = 80;
  mtmn_config.pyramid = 0.707;
  mtmn_config.pyramid_times = 4;
  mtmn_config.p_threshold.score = 0.6;
  mtmn_config.p_threshold.nms = 0.7;
  mtmn_config.p_threshold.candidate_number = 20;
  mtmn_config.r_threshold.score = 0.7;
  mtmn_config.r_threshold.nms = 0.7;
  mtmn_config.r_threshold.candidate_number = 10;
  mtmn_config.o_threshold.score = 0.7;
  mtmn_config.o_threshold.nms = 0.7;
  mtmn_config.o_threshold.candidate_number = 1;
  return mtmn_config;
}

mtmn_config_t mtmn_config = app_mtmn_config();
int pan_center = 90; // center the pan servo
int tilt_center = 90; // center the tilt servo
 
// Arduino like analogWrite
// value has to be between 0 and valueMax
void ledcAnalogWrite(uint8_t channel, uint32_t value, uint32_t valueMax = 180) {
  // calculate duty, 8191 from 2 ^ 13 - 1
  uint32_t duty = (8191 / valueMax) * min(value, valueMax);
  ledcWrite(channel, duty);
}


static void draw_face_boxes(dl_matrix3du_t *image_matrix, box_array_t *boxes)
{
  int x, y, w, h, i, half_width, half_height;
  uint32_t color = FACE_COLOR_GREEN;
  fb_data_t fb;
  fb.width = image_matrix->w;
  fb.height = image_matrix->h;
  fb.data = image_matrix->item;
  fb.bytes_per_pixel = 3;
  fb.format = FB_BGR888;
  for (i = 0; i < boxes->len; i++) {
 
    // Convoluted way of finding face centre...
    x = ((int)boxes->box[i].box_p[0]);
    w = (int)boxes->box[i].box_p[2] - x + 1;
    half_width = w / 2;
    int face_center_pan = x + half_width; // image frame face centre x co-ordinate
 
    y = (int)boxes->box[i].box_p[1];
    h = (int)boxes->box[i].box_p[3] - y + 1;
    half_height = h / 2;
    int face_center_tilt = y + half_height;  // image frame face centre y co-ordinate
 
    //    assume QVGA 320x240
    //    int sensor_width = 320;
    //    int sensor_height = 240;
    //    int lens_fov = 45
    //    float diagonal = sqrt(sq(sensor_width) + sq(sensor_height)); // pixels along the diagonal
    //    float pixels_per_degree = diagonal / lens_fov;
    //    400/45 = 8.89
    if(g_state==AUTO_MODE_ON)
    {
      float move_to_x = pan_center + ((-160 + face_center_pan) / 8.89) ;
      pan_center = (pan_center + move_to_x) / 2;
      Serial.println(pan_center);
      ledcAnalogWrite(2, pan_center); // channel, 0-180
      
    }

    else 
    {
      float move_to_x = pan_center + ((-160 + face_center_pan) / 8.89) ;
      float move_to_y = tilt_center + ((-120 + face_center_tilt) / 8.89) ;
   
      pan_center = (pan_center + move_to_x) / 2;
      Serial.println(pan_center);
      ledcAnalogWrite(2, pan_center); // channel, 0-180
   
      tilt_center = (tilt_center + move_to_y) / 2;
      int reversed_tilt_center = map(tilt_center, 0, 180, 180, 0);
      ledcAnalogWrite(4, reversed_tilt_center); // channel, 0-180
    //}

    fb_gfx_drawFastHLine(&fb, x, y, w, color);
    fb_gfx_drawFastHLine(&fb, x, y + h - 1, w, color);
    fb_gfx_drawFastVLine(&fb, x, y, h, color);
    fb_gfx_drawFastVLine(&fb, x + w - 1, y, h, color);
 
  }
}}
 
void setup() {
  WRITE_PERI_REG(RTC_CNTL_BROWN_OUT_REG, 0); //disable brownout detector
  Serial.begin(115200);

  //DC motors
  pinMode(14,OUTPUT);   

  //micro motor
  pinMode(15,OUTPUT); 

  digitalWrite(14, LOW);
  digitalWrite(15, LOW);
  // Ai-Thinker: pins 2 and 12
  ledcSetup(2, 50, 16); //channel, freq, resolution
  ledcAttachPin(2, 2); // pin, channel
  ledcSetup(4, 50, 16);
  ledcAttachPin(12, 4);
   
  camera_config_t config;
  config.ledc_channel = LEDC_CHANNEL_0;
  config.ledc_timer = LEDC_TIMER_0;
  config.pin_d0 = Y2_GPIO_NUM;
  config.pin_d1 = Y3_GPIO_NUM;
  config.pin_d2 = Y4_GPIO_NUM;
  config.pin_d3 = Y5_GPIO_NUM;
  config.pin_d4 = Y6_GPIO_NUM;
  config.pin_d5 = Y7_GPIO_NUM;
  config.pin_d6 = Y8_GPIO_NUM;
  config.pin_d7 = Y9_GPIO_NUM;
  config.pin_xclk = XCLK_GPIO_NUM;
  config.pin_pclk = PCLK_GPIO_NUM;
  config.pin_vsync = VSYNC_GPIO_NUM;
  config.pin_href = HREF_GPIO_NUM;
  config.pin_sscb_sda = SIOD_GPIO_NUM;
  config.pin_sscb_scl = SIOC_GPIO_NUM;
  config.pin_pwdn = PWDN_GPIO_NUM;
  config.pin_reset = RESET_GPIO_NUM;
  config.xclk_freq_hz = 20000000;
  config.pixel_format = PIXFORMAT_JPEG;
  //init with high specs to pre-allocate larger buffers
  if (psramFound()) {
    config.frame_size = FRAMESIZE_UXGA;
    config.jpeg_quality = 10;
    config.fb_count = 2;
  } else {
    config.frame_size = FRAMESIZE_SVGA;
    config.jpeg_quality = 12;
    config.fb_count = 1;
  }
   
  // camera init
  esp_err_t err = esp_camera_init(&config);
  if (err != ESP_OK) {
    Serial.printf("Camera init failed with error 0x%x", err);
    return;
  }
 
  sensor_t * s = esp_camera_sensor_get();
  s->set_framesize(s, FRAMESIZE_QVGA);
   
  WiFi.mode(WIFI_STA);
  WiFi.begin(ssid, password);
 
  // Wait for connection
  while (WiFi.status() != WL_CONNECTED) {
    delay(500);
    Serial.print(".");
  }
 
  Serial.println("");
  Serial.print("Connected to ");
  Serial.print("IP address: ");
  Serial.println(WiFi.localIP());
 
  webserver.on("/", HTTP_GET, [](AsyncWebServerRequest * request) {
    AsyncWebServerResponse *response = request->beginResponse_P(200, "text/html", index_html_gz, sizeof(index_html_gz));
    response->addHeader("Content-Encoding", "gzip");
    request->send(response);
  });
 
  webserver.begin();
  WSserver.listen(82);
}
 
 
void handle_message(WebsocketsMessage msg) {
  
  Serial.println(msg.data());

  if(msg.data()=="start-stream")
  {
    g_state= START_STREAM;
  }

  else if(msg.data()=="stop-stream")
  {
    g_state= STOP_STREAM;
  }

   else if(msg.data()=="toggle-motors")
  {
    //g_state= STOP_STREAM;
    digitalWrite(14, HIGH);
    digitalWrite(15, HIGH);
    ledcAnalogWrite(2, 90); // channel, 0-180
    ledcAnalogWrite(4, 90); // channel, 0-180
  }

  else if(msg.data()=="Auto_mode_on")
  {
    auto_mode = true;
  }

  else if(msg.data()=="Auto_mode_off")
  {
    auto_mode = false;
  }
  
  else if(msg.data()=="Motor_action")
  {
    int i =0;
    while(1)
    {
      i++;
      delay(1000);
      if(i<=1)
      {
        digitalWrite(15, HIGH);
        i=0;  
      }
    }      
  }
  
  
  int commaIndex = msg.data().indexOf(',');
  int panValue = msg.data().substring(0, commaIndex).toInt();
  int tiltValue = msg.data().substring(commaIndex + 1).toInt();
 
  panValue = map(panValue, -90, 90, 0, 180); // 0-180
  tiltValue = map(tiltValue, -90, 90, 180, 0); // 0-180 reversed
 
  ledcAnalogWrite(2, panValue); // channel, value
  ledcAnalogWrite(4, tiltValue);
}

uint32_t timeMotor_14;
uint32_t timeMotor_15;

boolean motor_14_state = false;
boolean motor_15_state = false;

 
void loop() {
  auto client = WSserver.accept();
  client.onMessage(handle_message);

 
  
  while (client.available()) {
    client.poll();

    if(g_state==START_STREAM)
    {
       fb = esp_camera_fb_get();

      image_matrix = dl_matrix3du_alloc(1, fb->width, fb->height, 3);
         
      fmt2rgb888(fb->buf, fb->len, fb->format, image_matrix->item);
 
      box_array_t *net_boxes = NULL;
      net_boxes = face_detect(image_matrix, &mtmn_config);
      
      
      if(auto_mode==true)
      {
          if ((net_boxes)&&(false==motor_14_state)&&(false==motor_15_state))
          {
            draw_face_boxes(image_matrix, net_boxes);
            free(net_boxes->score);
            free(net_boxes->box);
            free(net_boxes->landmark);
            free(net_boxes);
  
            //Capture time for enabling motor 14
            timeMotor_14 = millis();
  
            //Set state of motor 14 to true to switch it on
            motor_14_state = true;
  
            //Capture time for enabling motor 15
            timeMotor_15 = millis();
  
            //Set state of motor 15 to true to switch it on
            motor_15_state = true;
         }

           //if face detection enables motor_14...
          if( motor_14_state == true )
          {
              //switch on the motors for 1 second
              if( (millis() - timeMotor_14) <= 1000ul )
              {
                  //if yes, turn on the motor
                  digitalWrite(14, HIGH);
              }//if
      
              else 
              {
                 //turn off the motor
                  digitalWrite(14, LOW);
                  //and indiacte the motor is now off
                  motor_14_state = false;
              }
              
          }//if

             //if face detection enables motor_15...
            if( motor_15_state == true )
            {
                //switch on the motors for 5 seconds
                if( (millis() - timeMotor_15) <= 5000ul )
                {
                    //if yes, turn on the motor
                    digitalWrite(15, HIGH);
                }//if
        
                else 
                {
                    //turn off the motor
                    digitalWrite(15, LOW);
                    //and indiacte the motor is now off
                    motor_15_state = false;
                }
                
            }//if
     }
      else 
      {
        //do not process face traking
      }

//     //if face detection enables motor_14...
//    if( motor_14_state == true )
//    {
//        //switch on the motors for 1 second
//        if( (millis() - timeMotor_14) <= 1000ul )
//        {
//            //if yes, turn on the motor
//            digitalWrite(14, HIGH);
//        }//if
//
//        else 
//        {
//           //turn off the motor
//            digitalWrite(14, LOW);
//            //and indiacte the motor is now off
//            motor_14_state = false;
//        }
//        
//    }//if
//
//     //if face detection enables motor_15...
//    if( motor_15_state == true )
//    {
//        //switch on the motors for 5 seconds
//        if( (millis() - timeMotor_15) <= 5000ul )
//        {
//            //if yes, turn on the motor
//            digitalWrite(15, HIGH);
//        }//if
//
//        else 
//        {
//           //turn off the motor
//            digitalWrite(15, LOW);
//            //and indiacte the motor is now off
//            motor_15_state = false;
//        }
//        
//    }//if

      client.sendBinary((const char *)fb->buf, fb->len);
      esp_camera_fb_return(fb);
      fb = NULL;
      dl_matrix3du_free(image_matrix);
      }
  }
}
